// Lily58: 58 keys — wraps the shared 5×3+3 base with:
//   • a number row (all &none)
//   • an outer pinky column on each side (all &none)
//   • encoder positions bottom row (all &none)
//   • an extra outer thumb key on each side (all &none)
#define LILY58_STANDARD_LABELS 1
#include "zmk-helpers/key-labels/lily58.h"

#define NUM_ROW XXX XXX XXX XXX XXX XXX XXX XXX XXX XXX XXX XXX
#define ENCODERS XXX XXX

#define ZMK_BASE_LAYER(name, LT, RT, LM, RM, LB, RB, LH, RH) \
    ZMK_LAYER(name,                                          \
        NUM_ROW                                              \
        XXX LT          RT  XXX                              \
        XXX LM          RM  XXX                              \
        XXX LB ENCODERS RB  XXX                              \
        XXX LH          RH  XXX                              \
    )

#include "base.keymap"

/* vim: set ft=c tw=146: */
